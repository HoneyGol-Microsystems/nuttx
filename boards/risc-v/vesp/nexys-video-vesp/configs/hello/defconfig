## boards/risc-v/vesp/nexys-video-vesp/configs/hello/defconfig
```kconfig
# Arch
CONFIG_ARCH="risc-v"
CONFIG_ARCH_RISCV=y
#
# Board
CONFIG_ARCH_BOARD="nexys-video-vesp"
CONFIG_ARCH_BOARD_NEXYS_VIDEO_VESP=y
CONFIG_ARCH_BOARD_COMMON=y
#
# Chip
CONFIG_ARCH_CHIP="vesp"
CONFIG_ARCH_CHIP_VESP=y
#
# Debug
CONFIG_DEBUG_SYMBOLS=y
CONFIG_RAW_DISASSEMBLY=y
#
# IO
CONFIG_ARCH_LEDS=y
CONFIG_ARCH_LEDS_CPU_ACTIVITY=y
CONFIG_DEV_GPIO=y
CONFIG_DEV_GPIO_NSIGNALS=32
#
# Timer
CONFIG_SYSTEM_TIME64=y
CONFIG_ONESHOT=y
CONFIG_ALARM_ARCH=y
#
# System
CONFIG_HOST_LINUX=y
CONFIG_RAW_BINARY=y
# CONFIG_DEFAULT_SMALL=y
CONFIG_RISCV_TOOLCHAIN_GNU_RV64=y
CONFIG_DEV_NULL=n
CONFIG_RAM_SIZE=524288
CONFIG_RAM_START=0x0
CONFIG_BOOT_RUNFROMEXTSRAM=y
CONFIG_INIT_STACKSIZE=2048
CONFIG_DEFAULT_TASK_STACKSIZE=2048
CONFIG_IDLETHREAD_STACKSIZE=2048
CONFIG_PTHREAD_STACK_DEFAULT=2048
#
# App
CONFIG_EXAMPLES_HELLO=y
CONFIG_EXAMPLES_HELLO_PROGNAME="hello"
CONFIG_INIT_ENTRYPOINT="hello_main"
CONFIG_EXAMPLES_HELLO_PRIORITY=100
CONFIG_EXAMPLES_HELLO_STACKSIZE=2048
#
CONFIG_SYSLOG_DEFAULT=y
CONFIG_ARCH_LOWPUTC=y
```
